/*******************************************************************************
* Title                 :   ------
* Filename              :   udp_client.c
* Author                :   Carlos Herrera Trujillo
* Origin Date           :   Jun 8, 2024
* Version               :   x.0.0
* Compiler              :   ------
* Target                :   STM32XXX
* Notes                 :   
*******************************************************************************/

/******************************************************************************
* Private Preprocessor Constants
*******************************************************************************/


/******************************************************************************
* Private Includes
*******************************************************************************/
#include "udp_client.h"
#include "lwip/pbuf.h"
#include "lwip/udp.h"
#include <string.h>
#include <stdio.h>
/******************************************************************************
* Private defines
*******************************************************************************/


#define UDP_DATA_SIZE	1024
/******************************************************************************
* Private Typedefs
*******************************************************************************/


/******************************************************************************
* Private Macros
*******************************************************************************/


/******************************************************************************
* Public Variables
*******************************************************************************/


/******************************************************************************
* Private Variables
*******************************************************************************/
struct udp_pcb *upcb;
uint8_t data_payload[1024];
/******************************************************************************
* Private Function Prototypes
*******************************************************************************/


/******************************************************************************
* Public Function Prototypes
*******************************************************************************/


/////////////////////////////////////////////////////////////////////////////////
/////////////////////////////////Definitions/////////////////////////////////////
/////////////////////////////////////////////////////////////////////////////////


/******************************************************************************
* Private Function Definitions
*******************************************************************************/
static void udpclient_receiveCB(void *arg, struct udp_pcb *pcb, struct pbuf *p, const ip_addr_t *addr, u16_t port);


/******************************************************************************
* Public Function Definitions
*******************************************************************************/
void udpclient_Init(uint8_t ip0, uint8_t ip1, uint8_t ip2, uint8_t ip3, uint16_t port)
{
	struct ip4_addr DestIPaddr;
	err_t err;

	upcb = udp_new();

	if (upcb != NULL) {
		IP4_ADDR(&DestIPaddr, ip0, ip1, ip2, ip3);

		err = udp_connect(upcb, &DestIPaddr, port);

		if (err == ERR_OK) {
			udp_recv(upcb, udpclient_receiveCB, NULL);
		} else {
			udp_remove(upcb);
		}
	}

}

void udpclient_client_send(char *data_msg, uint16_t datasize)
{
	struct pbuf *p;
//	err_t err;

	memcpy(data_payload, data_msg, datasize);

	p = pbuf_alloc(PBUF_TRANSPORT, datasize, PBUF_POOL);

	if (p != NULL) {
		pbuf_take(p, data_payload, datasize);

//		err = udp_send(upcb, p);
		udp_send(upcb, p);

		pbuf_free(p);
	}
}

static void udpclient_receiveCB(void *arg, struct udp_pcb *pcb, struct pbuf *p, const ip_addr_t *addr, u16_t port)
{
	pbuf_free(p);
}
/////////////////////////////////////////////////////////////////////////////////
/////////////////////////////////////////////////////////////////////////////////
/////////////////////////////////////////////////////////////////////////////////
/*************** END OF FUNCTIONS *********************************************/
